/* Copyright (c) 2015, The Linux Foundation. All rights reserved.
 *
 * This program is free software; you can redistribute it and/or modify
 * it under the terms of the GNU General Public License version 2 and
 * only version 2 as published by the Free Software Foundation.
 *
 * This program is distributed in the hope that it will be useful,
 * but WITHOUT ANY WARRANTY; without even the implied warranty of
 * MERCHANTABILITY or FITNESS FOR A PARTICULAR PURPOSE.  See the
 * GNU General Public License for more details.
 */
/*---------------------------------------------------------------------------
 * This file is autogenerated file using gcdb parser. Please do not edit it.
 * Update input XML file to add a new entry or update variable in this file
 * VERSION = "1.0"
 *---------------------------------------------------------------------------*/
&mdss_mdp {
    dsi_panel_m80_42_02_0a_dsc_video: qcom,mdss_dsi_m80_42_02_0a_dsc_video {
        qcom,mdss-dsi-panel-name = "xiaomi m80 42 02 0a video mode dual dsi dphy panel";
        qcom,mdss-dsi-panel-type = "dsi_video_mode";
        qcom,mdss-dsi-stream = <0>;
        qcom,mdss-dsi-bpp = <24>;
        qcom,mdss-dsi-underflow-color = <0xff>;
        qcom,mdss-dsi-border-color = <0>;
        qcom,mdss-dsi-traffic-mode = "burst_mode";
        qcom,mdss-dsi-bllp-eof-power-mode;
        qcom,mdss-dsi-bllp-power-mode;
        qcom,mdss-dsi-lp11-init;
        qcom,mdss-dsi-virtual-channel-id = <0>;
        qcom,mdss-dsi-lane-0-state;
        qcom,mdss-dsi-lane-1-state;
        qcom,mdss-dsi-lane-2-state;
        qcom,mdss-dsi-lane-3-state;
        qcom,mdss-dsi-dma-trigger = "trigger_sw";
        qcom,mdss-dsi-mdp-trigger = "none";
        qcom,mdss-dsi-reset-sequence = <1 1>, <0 3>, <1 15>;
        qcom,adjust-timer-wakeup-ms = <1>;
        qcom,mdss-pan-physical-width-dimension = <3015>;
        qcom,mdss-pan-physical-height-dimension = <1884>;
        mi,mdss-dsi-fac-bl-max-level = <2047>;
        mi,mdss-fac-brightness-max-level = <2047>;
        qcom,mdss-dsi-tx-eot-append;
        qcom,mdss-dsi-rx-eot-ignore;
        qcom,cmd-sync-wait-broadcast;
        qcom,mdss-dsi-panel-broadcast-mode;
        // qcom,esd-check-enabled;
        qcom,mdss-dsi-panel-status-check-mode ="irq_check";
        qcom,mdss-dsi-panel-status-command = [06 01 00 00 00 00 01 0A];
        qcom,mdss-dsi-panel-status-command-state = "dsi_lp_mode";
        qcom,mdss-dsi-panel-status-value = <0x9D>;
        qcom,mdss-dsi-panel-status-read-length = <1>;
        qcom,bl-update-flag = "delay_until_first_frame";
        qcom,mdss-dsi-panel-hdr-enabled;
        qcom,mdss-dsi-panel-hdr-color-primaries = <14500 15500 32000
            17000 15500 30000 8000 3000>;
        qcom,mdss-dsi-panel-peak-brightness = <4200000>;
        qcom,mdss-dsi-panel-blackness-level = <3230>;

        qcom,mdss-dsi-pan-enable-dynamic-fps;
        qcom,mdss-dsi-pan-fps-update = "dfps_immediate_porch_mode_vfp";
        qcom,dsi-supported-dfps-list = <120 60 90 50 48 30>;
        qcom,mdss-dsi-display-timings {
            timing@0{
                qcom,mdss-dsi-panel-framerate = <120>;
                qcom,mdss-dsi-panel-width = <1440>; // dual dsi is 2880/2
                qcom,mdss-dsi-panel-height = <1800>;
                qcom,mdss-dsi-h-pulse-width = <10>;
                qcom,mdss-dsi-h-back-porch = <38>;
                qcom,mdss-dsi-h-front-porch = <65>;
                qcom,mdss-dsi-h-sync-skew = <0>;
                qcom,mdss-dsi-v-pulse-width = <2>;
                qcom,mdss-dsi-v-back-porch = <118>;
                qcom,mdss-dsi-v-front-porch = <26>;
                qcom,mdss-dsi-h-left-border = <0>;
                qcom,mdss-dsi-h-right-border = <0>;
                qcom,mdss-dsi-v-top-border = <0>;
                qcom,mdss-dsi-v-bottom-border = <0>;
                qcom,mdss-dsi-panel-clockrate = <830950000>;

                qcom,mdss-dsi-on-command= [
                        /*esd config*/
                        39 00 00 40 00 00 02 FF 27
                        39 00 00 40 00 00 02 FB 01
                        39 00 00 40 00 00 02 D0 31
                        39 00 00 40 00 00 02 D1 20
                        39 00 00 40 00 00 02 D2 38
                        39 00 00 40 00 00 02 DE 43
                        39 00 00 40 00 00 02 DF 02
                        //CABC start
                        39 00 00 40 00 00 02 FF 23
                        39 00 00 40 00 00 02 FB 01
                        39 00 00 40 00 00 02 00 80
                        39 00 00 40 00 00 02 01 84
                        39 00 00 40 00 00 02 05 2D
                        39 00 00 40 00 00 02 06 00
                        39 00 00 40 00 00 02 11 03
                        39 00 00 40 00 00 02 12 2A
                        39 00 00 40 00 00 02 15 D0
                        39 00 00 40 00 00 02 16 16
                        //UI mode
                        39 00 00 40 00 00 02 29 0A
                        39 00 00 40 00 00 02 30 FF
                        39 00 00 40 00 00 02 31 FE
                        39 00 00 40 00 00 02 32 FD
                        39 00 00 40 00 00 02 33 FB
                        39 00 00 40 00 00 02 34 F8
                        39 00 00 40 00 00 02 35 F5
                        39 00 00 40 00 00 02 36 F3
                        39 00 00 40 00 00 02 37 F2
                        39 00 00 40 00 00 02 38 F2
                        39 00 00 40 00 00 02 39 F2
                        39 00 00 40 00 00 02 3A EF
                        39 00 00 40 00 00 02 3B EC
                        39 00 00 40 00 00 02 3D E9
                        39 00 00 40 00 00 02 3F E5
                        39 00 00 40 00 00 02 40 E5
                        39 00 00 40 00 00 02 41 E5
                        //STILL mode
                        39 00 00 40 00 00 02 2A 13
                        39 00 00 40 00 00 02 45 FF
                        39 00 00 40 00 00 02 46 F4
                        39 00 00 40 00 00 02 47 E7
                        39 00 00 40 00 00 02 48 DA
                        39 00 00 40 00 00 02 49 CD
                        39 00 00 40 00 00 02 4A C0
                        39 00 00 40 00 00 02 4B B3
                        39 00 00 40 00 00 02 4C B1
                        39 00 00 40 00 00 02 4D B1
                        39 00 00 40 00 00 02 4E B1
                        39 00 00 40 00 00 02 4F 95
                        39 00 00 40 00 00 02 50 79
                        39 00 00 40 00 00 02 51 5C
                        39 00 00 40 00 00 02 52 58
                        39 00 00 40 00 00 02 53 58
                        39 00 00 40 00 00 02 54 58
                        //MOVING mode
                        39 00 00 40 00 00 02 2B 0E
                        39 00 00 40 00 00 02 58 FF
                        39 00 00 40 00 00 02 59 FB
                        39 00 00 40 00 00 02 5A F7
                        39 00 00 40 00 00 02 5B F3
                        39 00 00 40 00 00 02 5C EF
                        39 00 00 40 00 00 02 5D E3
                        39 00 00 40 00 00 02 5E D8
                        39 00 00 40 00 00 02 5F D6
                        39 00 00 40 00 00 02 60 D6
                        39 00 00 40 00 00 02 61 D6
                        39 00 00 40 00 00 02 62 C8
                        39 00 00 40 00 00 02 63 B7
                        39 00 00 40 00 00 02 64 AA
                        39 00 00 40 00 00 02 65 A8
                        39 00 00 40 00 00 02 66 A8
                        39 00 00 00 00 00 02 67 A8
                        //CABC end
                        //------Initial Code Update----(start)
                        39 00 00 00 00 00 02 FF 2A
                        39 00 00 00 00 00 02 FB 01
                        39 00 00 00 00 00 03 BC 77 07
                        39 00 00 00 00 00 02 FF 26
                        39 00 00 00 00 00 02 FB 01
                        39 00 00 00 00 00 02 04 6E
                        39 00 00 00 00 00 02 8B 37
                        39 00 00 00 00 00 02 FF 22
                        39 00 00 00 00 00 02 FB 01
                        39 00 00 00 00 00 02 9F 52
                        39 00 00 00 00 00 02 FF 27
                        39 00 00 00 00 00 02 FB 01
                        39 00 00 00 00 00 03 0E 35 40
                        39 00 00 00 00 00 02 FF 10
                        39 00 00 40 00 00 03 51 0F FF
                        39 00 00 40 00 00 02 53 24
                        39 00 00 00 00 00 02 35 00
                        39 00 00 00 00 00 02 FF 27
                        39 00 00 00 00 00 02 FB 01
                        39 00 00 00 00 00 02 13 00
                        39 00 00 00 00 00 02 14 33
                        39 00 00 00 00 00 02 FF 20
                        39 00 00 00 00 00 02 FB 01
                        39 00 00 00 00 00 02 F2 00
                        39 00 00 00 00 00 02 F3 00
                        39 00 00 00 00 00 02 F4 00
                        39 00 00 00 00 00 02 F5 00
                        39 00 00 00 00 00 02 F6 00
                        39 00 00 00 00 00 02 F9 00
                        39 00 00 00 00 00 02 17 11
                        39 00 00 00 00 00 02 FF E0
                        39 00 00 00 00 00 02 FB 01
                        39 00 00 00 00 00 02 46 07
                        //------Initial Code Update-----(end)
                        39 00 00 00 00 00 02 FF 10
                        39 00 00 00 00 00 02 FB 01
                        39 00 00 00 00 00 02 B2 91
                        39 00 00 00 00 00 02 B3 40
                        39 00 00 00 00 00 02 FF 10
                        39 00 00 00 00 00 02 FB 01
                        39 00 00 00 00 00 07 3B 03 78 1A 0A 0A 00
                        39 00 00 00 64 00 01 11
                        39 00 00 00 00 00 01 29
                        ];
                qcom,mdss-dsi-off-command = [
                        39 00 00 40 00 00 02 FF 27
                        39 00 00 00 00 00 02 D1 20
                        39 00 00 40 00 00 02 FF 10
                        05 00 00 00 00 00 02 28 00
                        05 00 00 00 64 00 02 10 00];
                qcom,mdss-dsi-displayoff-command = [05 00 00 00 20 00 02 28 00];
                qcom,mdss-dsi-displayon-command = [05 00 00 00 14 00 02 29 00];
                qcom,mdss-dsi-on-command-state = "dsi_lp_mode";
                qcom,mdss-dsi-off-command-state = "dsi_lp_mode";
                qcom,mdss-dsi-displayoff-command-state = "dsi_hs_mode";
                qcom,mdss-dsi-displayon-command-state = "dsi_hs_mode";
                qcom,compression-mode = "dsc";
                qcom,mdss-dsc-version = <0x11>;
                qcom,mdss-dsc-scr-version = <0x0>;
                qcom,mdss-dsc-slice-height = <20>;
                qcom,mdss-dsc-slice-width = <720>;
                qcom,mdss-dsc-slice-per-pkt = <2>;
                qcom,mdss-dsc-bit-per-component = <8>;
                qcom,mdss-dsc-bit-per-pixel = <8>;
                qcom,mdss-dsc-block-prediction-enable;
                qcom,mdss-dsi-dispparam-pen-120hz-command = [
                        39 00 00 40 00 00 02 FF 10
                        39 00 00 40 00 00 02 B2 91
                        39 00 00 00 00 00 02 B3 40
                        ];
                qcom,mdss-dsi-dispparam-pen-60hz-command = [
                        39 00 00 40 00 00 02 FF 10
                        39 00 00 40 00 00 02 B2 91
                        39 00 00 00 00 00 02 B3 40
                        ];
                 qcom,mdss-dsi-dispparam-pen-90hz-command = [
                       39 00 00 40 00 00 02 FF 10
                       39 00 00 40 00 00 02 B2 00
                       39 00 00 00 00 00 02 B3 80
                        ];
                 qcom,mdss-dsi-dispparam-pen-50hz-command = [
                       39 00 00 40 00 00 02 FF 10
                       39 00 00 40 00 00 02 B2 00
                       39 00 00 00 00 00 02 B3 80
                        ];
                 qcom,mdss-dsi-dispparam-pen-48hz-command = [
                       39 00 00 40 00 00 02 FF 10
                       39 00 00 40 00 00 02 B2 00
                       39 00 00 00 00 00 02 B3 80
                        ];
                qcom,mdss-dsi-dispparam-pen-30hz-command = [
                       39 00 00 40 00 00 02 FF 10
                       39 00 00 40 00 00 02 B2 00
                       39 00 00 00 00 00 02 B3 80
                        ];
                mi,mdss-dsi-dispparam-pen-clear-command = [
                        39 00 00 40 00 00 02 FF 10
                        39 00 00 40 00 00 02 FB 01
                        39 00 00 00 00 00 02 B2 80
			            ];
                qcom,mdss-dsi-dispparam-pen-120hz-command-state = "dsi_lp_mode";
                qcom,mdss-dsi-dispparam-pen-60hz-command-state = "dsi_lp_mode";
                qcom,mdss-dsi-dispparam-pen-30hz-command-state = "dsi_lp_mode";
                qcom,mdss-dsi-dispparam-pen-50hz-command-state = "dsi_lp_mode";
                qcom,mdss-dsi-dispparam-pen-90hz-command-state = "dsi_lp_mode";
                qcom,mdss-dsi-dispparam-pen-48hz-command-state = "dsi_lp_mode";
                mi,mdss-dsi-dispparam-pen-clear-command-state = "dsi_lp_mode";
            };
        };
    };
};
&dsi_panel_m80_42_02_0a_dsc_video {
    mi,panel-id = <0x004D3830 0x00420200>;
    mi,feature-enabled;
    mi,is-tddi-flag;
    mi,mdss-panel-on-dimming-delay = <300>;
    mi,esd-err-irq-gpio = <&tlmm 20 0x2004>; /* trig-flags: high-0x0004 rasing-0x0001*/
    mi,esd-err-irq-gpio-second = <&tlmm 116 0x2004>; /* trig-flags: high-0x0004 rasing-0x0001*/
    mi,mdss-dsi-panel-xy-coordinate = <0x6 0x18>;
    mi,mdss-dsi-panel-max-luminance = <0x6 0x4>;
    mi,thermal-dimming-flag;
    qcom,mdss-dsi-display-timings {
        timing@0{
            mi,mdss-dsi-cabcuion-command = [
                15 00 00 00 00 00 02 FF 10
                15 00 00 00 00 00 02 55 01
            ];
            mi,mdss-dsi-cabcstillon-command = [
                15 00 00 00 00 00 02 FF 10
                15 00 00 00 00 00 02 55 02
            ];
            mi,mdss-dsi-cabcmovieon-command = [
                15 00 00 00 00 00 02 FF 10
                15 00 00 00 00 00 02 55 03
            ];
            mi,mdss-dsi-cabcoff-command = [
                15 00 00 00 00 00 02 FF 10
                15 00 00 00 00 00 02 55 00
            ];
            mi,mdss-dsi-dimmingon-command = [
                /* ESD Detection Signal */
                39 00 00 40 00 00 02 FF 27
                39 00 00 00 00 00 02 D1 28
                /* CABC DIMMING ON */
                15 00 00 00 00 00 02 FF 10
                15 00 00 00 00 00 02 53 2C
            ];
            mi,mdss-dsi-cabcuion-command-state = "dsi_lp_mode";
            mi,mdss-dsi-cabcstillon-command-state = "dsi_lp_mode";
            mi,mdss-dsi-cabcmovieon-command-state = "dsi_lp_mode";
            mi,mdss-dsi-cabcoff-command-state = "dsi_lp_mode";
            mi,mdss-dsi-dimmingon-command-state = "dsi_lp_mode";
            mi,mdss-dsi-xy-coordinate-command = [
                15 00 00 00 00 00 02 FF 10
                06 00 00 00 00 00 01 A1];
            mi,mdss-dsi-xy-coordinate-command-state = "dsi_lp_mode";
            mi,mdss-dsi-max-luminance-write-command = [
                15 00 00 00 00 00 02 FF 10];
            mi,mdss-dsi-max-luminance-write-command-state = "dsi_lp_mode";
            mi,mdss-dsi-max-luminance-read-command = [
                06 00 00 00 00 00 01 A1];
            mi,mdss-dsi-max-luminance-read-command-state = "dsi_lp_mode";
            mi,mdss-dsi-disable-insert-black-command = [
                15 00 00 40 00 00 02 FF 10
                15 00 00 40 00 00 02 FB 01
                05 00 00 00 00 00 02 13 00];
            mi,mdss-dsi-disable-insert-black-command-state = "dsi_lp_mode";
            mi,mdss-dsi-insert-black-screen-command = [
                15 00 00 40 00 00 02 FF 10
                15 00 00 40 00 00 02 FB 01
                05 00 00 00 00 00 02 22 00];
            mi,mdss-dsi-insert-black-screen-command-state = "dsi_lp_mode";
        };
    };
};
